## buildroot/Config.in
```kconfig
source "$BR2_EXTERNAL_GLOWBARN_EXTERNAL_PATH/package/glowbarn/Config.in"
source "$BR2_EXTERNAL_GLOWBARN_EXTERNAL_PATH/package/glowbarn-sensors/Config.in"
```

## buildroot/configs/glowbarn_rpi4_defconfig
```kconfig
# GlowBarn OS for Raspberry Pi 4
# Paranormal Research Operating System
# Based on Buildroot 2024.02.x

# Architecture
BR2_aarch64=y

# Raspberry Pi 4 target
BR2_PACKAGE_HOST_LINUX_HEADERS_CUSTOM_6_6=y
BR2_PACKAGE_HOST_LINUX_HEADERS_CUSTOM_6_1=n

# System
BR2_TARGET_GENERIC_HOSTNAME="glowbarn"
BR2_TARGET_GENERIC_ISSUE="Welcome to GlowBarn OS - Paranormal Research Operating System"
BR2_SYSTEM_DHCP="eth0"
BR2_TARGET_GENERIC_GETTY_PORT="tty1"
BR2_TARGET_GENERIC_GETTY_BAUDRATE_115200=y
BR2_TARGET_GENERIC_ROOT_PASSWD="glowbarn"

# Kernel
BR2_LINUX_KERNEL=y
BR2_LINUX_KERNEL_CUSTOM_TARBALL=y
BR2_LINUX_KERNEL_CUSTOM_TARBALL_LOCATION="https://github.com/raspberrypi/linux/archive/rpi-6.6.y.tar.gz"
BR2_LINUX_KERNEL_USE_CUSTOM_CONFIG=y
BR2_LINUX_KERNEL_CUSTOM_CONFIG_FILE="$(BR2_EXTERNAL_GLOWBARN_PATH)/board/glowbarn/rpi4_kernel.config"
BR2_LINUX_KERNEL_DTS_SUPPORT=y
BR2_LINUX_KERNEL_INTREE_DTS_NAME="broadcom/bcm2711-rpi-4-b"
BR2_LINUX_KERNEL_NEEDS_HOST_OPENSSL=y

# Bootloader
BR2_TARGET_UBOOT=n
BR2_PACKAGE_RPI_FIRMWARE=y
BR2_PACKAGE_RPI_FIRMWARE_VARIANT_PI4=y

# Filesystem
BR2_TARGET_ROOTFS_EXT2=y
BR2_TARGET_ROOTFS_EXT2_4=y
BR2_TARGET_ROOTFS_EXT2_SIZE="2G"
BR2_TARGET_ROOTFS_EXT2_MKFS_OPTIONS="-O ^metadata_csum,^64bit"
BR2_ROOTFS_OVERLAY="$(BR2_EXTERNAL_GLOWBARN_PATH)/overlay"
BR2_ROOTFS_POST_BUILD_SCRIPT="$(BR2_EXTERNAL_GLOWBARN_PATH)/board/glowbarn/post-build.sh"
BR2_ROOTFS_POST_IMAGE_SCRIPT="$(BR2_EXTERNAL_GLOWBARN_PATH)/board/glowbarn/post-image.sh"

# Custom scripts location
BR2_ROOTFS_POST_SCRIPT_ARGS="$(BR2_EXTERNAL_GLOWBARN_PATH)"

# genimage for SD card image
BR2_PACKAGE_HOST_GENIMAGE=y
BR2_PACKAGE_HOST_DOSFSTOOLS=y
BR2_PACKAGE_HOST_MTOOLS=y

# Init system
BR2_INIT_SYSTEMD=y
BR2_ROOTFS_DEVICE_CREATION_DYNAMIC_EUDEV=n

# Toolchain
BR2_TOOLCHAIN_BUILDROOT_GLIBC=y
BR2_TOOLCHAIN_BUILDROOT_CXX=y
BR2_ENABLE_LOCALE_PURGE=y

# Core packages
BR2_PACKAGE_BUSYBOX=y
BR2_PACKAGE_DROPBEAR=y
BR2_PACKAGE_DROPBEAR_CLIENT=y
BR2_PACKAGE_HTOP=y
BR2_PACKAGE_NANO=y
BR2_PACKAGE_BASH=y

# Networking
BR2_PACKAGE_DHCPCD=y
BR2_PACKAGE_DHCPCD_DUID_DISABLE=y
BR2_PACKAGE_WPASUPP=y
BR2_PACKAGE_WPASUPP_NL80211=y
BR2_PACKAGE_WPASUPP_WPA3=y
BR2_PACKAGE_IW=y
BR2_PACKAGE_WIRELESS_TOOLS=y
BR2_PACKAGE_HOSTAPD=y
BR2_PACKAGE_AVAHI=y
BR2_PACKAGE_AVAHI_DAEMON=y
BR2_PACKAGE_IPTABLES=y
BR2_PACKAGE_NFTABLES=y

# Python for GlowBarn app
BR2_PACKAGE_PYTHON3=y
BR2_PACKAGE_PYTHON3_2TO3=n
BR2_PACKAGE_PYTHON_PIP=y
BR2_PACKAGE_PYTHON_FLASK=y
BR2_PACKAGE_PYTHON_NUMPY=y
BR2_PACKAGE_PYTHON_PILLOW=y
BR2_PACKAGE_PYTHON_REQUESTS=y
BR2_PACKAGE_PYTHON_PYSERIAL=y
BR2_PACKAGE_PYTHON_FLASK_CORS=y

# GPIO and hardware access
BR2_PACKAGE_LIBGPIOD=y
BR2_PACKAGE_LIBGPIOD_TOOLS=y
BR2_PACKAGE_I2C_TOOLS=y
BR2_PACKAGE_SPI_TOOLS=y
BR2_PACKAGE_LIBSERIALPORT=y

# Audio for EVP detection
BR2_PACKAGE_ALSA_UTILS=y
BR2_PACKAGE_ALSA_LIB=y
BR2_PACKAGE_PULSEAUDIO=y
BR2_PACKAGE_PORTAUDIO=y

# Video/Camera
BR2_PACKAGE_LIBCAMERA=y
BR2_PACKAGE_LIBCAMERA_V4L2=y
BR2_PACKAGE_V4L_UTILS=y
BR2_PACKAGE_MJPG_STREAMER=y

# Display/GUI (headless option available)
BR2_PACKAGE_MESA3D=y
BR2_PACKAGE_MESA3D_GALLIUM_DRIVER_V3D=y
BR2_PACKAGE_MESA3D_GALLIUM_DRIVER_VC4=y
BR2_PACKAGE_MESA3D_OPENGL_ES=y
BR2_PACKAGE_WESTON=y
BR2_PACKAGE_WESTON_DRM=y
BR2_PACKAGE_CAGE=y

# Web server
BR2_PACKAGE_LIGHTTPD=y
BR2_PACKAGE_NGINX=n

# Database for logging
BR2_PACKAGE_SQLITE=y

# USB support
BR2_PACKAGE_EUDEV=y
BR2_PACKAGE_LIBUSB=y
BR2_PACKAGE_USBUTILS=y

# Thermal and environmental sensors
BR2_PACKAGE_LM_SENSORS=y

# Compression tools
BR2_PACKAGE_ZIP=y
BR2_PACKAGE_UNZIP=y
BR2_PACKAGE_XZ=y

# Development (optional, can be removed for production)
BR2_PACKAGE_GDB=y
BR2_PACKAGE_STRACE=y

# GlowBarn custom packages
BR2_PACKAGE_GLOWBARN=y
BR2_PACKAGE_GLOWBARN_SENSORS=y

# Timezone
BR2_TARGET_TZ_INFO=y
BR2_TARGET_LOCALTIME="America/New_York"

# Logo and branding
BR2_TARGET_GENERIC_ROOT_PASSWD="paranormal"
BR2_SYSTEM_BIN_SH_BASH=y
```

## buildroot/configs/glowbarn_x86_64_defconfig
```kconfig
# GlowBarn OS for x86_64
# Paranormal Research Operating System
# Live USB / PC Installation
# Based on Buildroot 2024.02.x

# Architecture
BR2_x86_64=y
BR2_x86_corei7=y

# System
BR2_TARGET_GENERIC_HOSTNAME="glowbarn"
BR2_TARGET_GENERIC_ISSUE="Welcome to GlowBarn OS - Paranormal Research Operating System"
BR2_SYSTEM_DHCP="eth0"
BR2_TARGET_GENERIC_GETTY_PORT="tty1"
BR2_TARGET_GENERIC_GETTY_BAUDRATE_115200=y
BR2_TARGET_GENERIC_ROOT_PASSWD="paranormal"

# Kernel
BR2_LINUX_KERNEL=y
BR2_LINUX_KERNEL_CUSTOM_VERSION=y
BR2_LINUX_KERNEL_CUSTOM_VERSION_VALUE="6.6.32"
BR2_LINUX_KERNEL_USE_CUSTOM_CONFIG=y
BR2_LINUX_KERNEL_CUSTOM_CONFIG_FILE="$(BR2_EXTERNAL_GLOWBARN_PATH)/board/glowbarn/x86_kernel.config"
BR2_LINUX_KERNEL_INSTALL_TARGET=y
BR2_LINUX_KERNEL_NEEDS_HOST_OPENSSL=y

# Bootloader - GRUB2 for x86
BR2_TARGET_GRUB2=y
BR2_TARGET_GRUB2_X86_64_EFI=y
BR2_TARGET_GRUB2_BUILTIN_MODULES_EFI="boot linux ext2 fat part_msdos part_gpt normal efi_gop"

# Filesystem
BR2_TARGET_ROOTFS_EXT2=y
BR2_TARGET_ROOTFS_EXT2_4=y
BR2_TARGET_ROOTFS_EXT2_SIZE="4G"
BR2_ROOTFS_OVERLAY="$(BR2_EXTERNAL_GLOWBARN_PATH)/overlay"
BR2_ROOTFS_POST_BUILD_SCRIPT="$(BR2_EXTERNAL_GLOWBARN_PATH)/board/glowbarn/post-build.sh"
BR2_ROOTFS_POST_IMAGE_SCRIPT="$(BR2_EXTERNAL_GLOWBARN_PATH)/board/glowbarn/post-image-x86.sh"

# Custom scripts location
BR2_ROOTFS_POST_SCRIPT_ARGS="$(BR2_EXTERNAL_GLOWBARN_PATH)"

# genimage for disk image
BR2_PACKAGE_HOST_GENIMAGE=y
BR2_PACKAGE_HOST_DOSFSTOOLS=y
BR2_PACKAGE_HOST_MTOOLS=y

# Init system
BR2_INIT_SYSTEMD=y

# Toolchain
BR2_TOOLCHAIN_BUILDROOT_GLIBC=y
BR2_TOOLCHAIN_BUILDROOT_CXX=y
BR2_ENABLE_LOCALE_PURGE=y

# Core packages
BR2_PACKAGE_BUSYBOX=y
BR2_PACKAGE_DROPBEAR=y
BR2_PACKAGE_DROPBEAR_CLIENT=y
BR2_PACKAGE_HTOP=y
BR2_PACKAGE_NANO=y
BR2_PACKAGE_BASH=y
BR2_PACKAGE_SUDO=y

# Networking
BR2_PACKAGE_DHCPCD=y
BR2_PACKAGE_WPASUPP=y
BR2_PACKAGE_WPASUPP_NL80211=y
BR2_PACKAGE_WPASUPP_WPA3=y
BR2_PACKAGE_IW=y
BR2_PACKAGE_WIRELESS_TOOLS=y
BR2_PACKAGE_HOSTAPD=y
BR2_PACKAGE_AVAHI=y
BR2_PACKAGE_AVAHI_DAEMON=y
BR2_PACKAGE_IPTABLES=y
BR2_PACKAGE_NFTABLES=y
BR2_PACKAGE_ETHTOOL=y

# Python for GlowBarn app
BR2_PACKAGE_PYTHON3=y
BR2_PACKAGE_PYTHON_PIP=y
BR2_PACKAGE_PYTHON_FLASK=y
BR2_PACKAGE_PYTHON_NUMPY=y
BR2_PACKAGE_PYTHON_PILLOW=y
BR2_PACKAGE_PYTHON_REQUESTS=y
BR2_PACKAGE_PYTHON_PYSERIAL=y
BR2_PACKAGE_PYTHON_FLASK_CORS=y
BR2_PACKAGE_PYTHON_SCIPY=y
BR2_PACKAGE_PYTHON_MATPLOTLIB=y

# GPIO and hardware access (USB adapters)
BR2_PACKAGE_LIBGPIOD=y
BR2_PACKAGE_LIBGPIOD_TOOLS=y
BR2_PACKAGE_I2C_TOOLS=y
BR2_PACKAGE_LIBSERIALPORT=y

# Audio for EVP detection
BR2_PACKAGE_ALSA_UTILS=y
BR2_PACKAGE_ALSA_LIB=y
BR2_PACKAGE_PULSEAUDIO=y
BR2_PACKAGE_PORTAUDIO=y
BR2_PACKAGE_SOX=y

# Video/Camera
BR2_PACKAGE_V4L_UTILS=y
BR2_PACKAGE_MJPG_STREAMER=y
BR2_PACKAGE_OPENCV4=y
BR2_PACKAGE_OPENCV4_WITH_V4L=y
BR2_PACKAGE_OPENCV4_LIB_PYTHON=y

# Display/GUI
BR2_PACKAGE_XORG7=y
BR2_PACKAGE_XSERVER_XORG_SERVER=y
BR2_PACKAGE_XDRIVER_XF86_VIDEO_VESA=y
BR2_PACKAGE_XDRIVER_XF86_VIDEO_FBDEV=y
BR2_PACKAGE_XDRIVER_XF86_INPUT_LIBINPUT=y
BR2_PACKAGE_MESA3D=y
BR2_PACKAGE_MESA3D_DRI_DRIVER_I965=y
BR2_PACKAGE_MESA3D_GALLIUM_DRIVER_IRIS=y
BR2_PACKAGE_MESA3D_GALLIUM_DRIVER_NOUVEAU=y
BR2_PACKAGE_MESA3D_GALLIUM_DRIVER_RADEONSI=y
BR2_PACKAGE_MESA3D_OPENGL_ES=y
BR2_PACKAGE_MESA3D_OPENGL_GLX=y
BR2_PACKAGE_WESTON=y
BR2_PACKAGE_WESTON_DRM=y
BR2_PACKAGE_CAGE=y

# GTK for potential GUI apps
BR2_PACKAGE_LIBGTK3=y

# Web server
BR2_PACKAGE_LIGHTTPD=y
BR2_PACKAGE_NGINX=y

# Database for logging
BR2_PACKAGE_SQLITE=y
BR2_PACKAGE_POSTGRESQL=y

# USB support
BR2_PACKAGE_EUDEV=y
BR2_PACKAGE_LIBUSB=y
BR2_PACKAGE_USBUTILS=y

# Thermal and environmental sensors
BR2_PACKAGE_LM_SENSORS=y

# Serial communication
BR2_PACKAGE_MINICOM=y
BR2_PACKAGE_SCREEN=y
BR2_PACKAGE_PICOCOM=y

# Compression tools
BR2_PACKAGE_ZIP=y
BR2_PACKAGE_UNZIP=y
BR2_PACKAGE_XZ=y
BR2_PACKAGE_P7ZIP=y

# Development tools
BR2_PACKAGE_GDB=y
BR2_PACKAGE_STRACE=y
BR2_PACKAGE_LTRACE=y
BR2_PACKAGE_VALGRIND=y

# Terminal utilities
BR2_PACKAGE_TMUX=y
BR2_PACKAGE_VIM=y
BR2_PACKAGE_NCURSES=y

# File utilities
BR2_PACKAGE_RSYNC=y
BR2_PACKAGE_TREE=y
BR2_PACKAGE_FILE=y

# GlowBarn custom packages
BR2_PACKAGE_GLOWBARN=y
BR2_PACKAGE_GLOWBARN_SENSORS=y

# Timezone
BR2_TARGET_TZ_INFO=y
BR2_TARGET_LOCALTIME="America/New_York"

# Shell
BR2_SYSTEM_BIN_SH_BASH=y

# Firmware for common WiFi/network cards
BR2_PACKAGE_LINUX_FIRMWARE=y
BR2_PACKAGE_LINUX_FIRMWARE_IWLWIFI_7260=y
BR2_PACKAGE_LINUX_FIRMWARE_IWLWIFI_8000C=y
BR2_PACKAGE_LINUX_FIRMWARE_IWLWIFI_8265=y
BR2_PACKAGE_LINUX_FIRMWARE_IWLWIFI_9000=y
BR2_PACKAGE_LINUX_FIRMWARE_IWLWIFI_AX200=y
BR2_PACKAGE_LINUX_FIRMWARE_IWLWIFI_AX201=y
BR2_PACKAGE_LINUX_FIRMWARE_RTL_8188=y
BR2_PACKAGE_LINUX_FIRMWARE_RTL_8192=y
BR2_PACKAGE_LINUX_FIRMWARE_ATHEROS_10K=y
BR2_PACKAGE_LINUX_FIRMWARE_RALINK_RT2XX=y
```

## buildroot/package/glowbarn-sensors/Config.in
```kconfig
config BR2_PACKAGE_GLOWBARN_SENSORS
	bool "glowbarn-sensors"
	depends on BR2_PACKAGE_GLOWBARN
	help
	  GlowBarn sensor drivers and hardware support packages.

if BR2_PACKAGE_GLOWBARN_SENSORS

config BR2_PACKAGE_GLOWBARN_SENSORS_I2C
	bool "I2C sensor support"
	default y
	select BR2_PACKAGE_I2C_TOOLS
	help
	  Enable I2C sensors (BME280, MLX90614, etc.)

config BR2_PACKAGE_GLOWBARN_SENSORS_GPIO
	bool "GPIO sensor support"
	default y
	select BR2_PACKAGE_LIBGPIOD
	help
	  Enable GPIO-based sensors

config BR2_PACKAGE_GLOWBARN_SENSORS_SDR
	bool "Software Defined Radio support"
	default n
	select BR2_PACKAGE_RTL_SDR
	select BR2_PACKAGE_LIBUSB
	help
	  Enable RTL-SDR support for RF monitoring

config BR2_PACKAGE_GLOWBARN_SENSORS_THERMAL
	bool "Thermal camera support"
	default n
	help
	  Enable thermal camera support (FLIR Lepton, etc.)

endif
```

## buildroot/package/glowbarn/Config.in
```kconfig
config BR2_PACKAGE_GLOWBARN
	bool "glowbarn"
	depends on BR2_PACKAGE_PYTHON3
	select BR2_PACKAGE_PYTHON_FLASK
	select BR2_PACKAGE_PYTHON_PYYAML
	select BR2_PACKAGE_PYTHON_FLASK_CORS
	help
	  GlowBarn - Paranormal Research Operating System Core

	  A comprehensive paranormal investigation platform with:
	  - Real-time sensor monitoring (EMF, temperature, humidity, etc.)
	  - EVP (Electronic Voice Phenomena) detection
	  - Night vision camera with motion detection
	  - Web-based dashboard interface
	  - Data logging and export

	  https://github.com/bad-antics/glowbarn-os

if BR2_PACKAGE_GLOWBARN

config BR2_PACKAGE_GLOWBARN_WEB
	bool "Enable web dashboard"
	default y
	help
	  Enable the web-based control dashboard
	  accessible at http://device-ip:8765

config BR2_PACKAGE_GLOWBARN_AUDIO
	bool "Enable audio/EVP detection"
	default y
	select BR2_PACKAGE_ALSA_LIB
	select BR2_PACKAGE_PORTAUDIO
	help
	  Enable audio capture for EVP detection and
	  ultrasonic/infrasonic analysis.

config BR2_PACKAGE_GLOWBARN_CAMERA
	bool "Enable camera support"
	default y
	select BR2_PACKAGE_LIBCAMERA
	select BR2_PACKAGE_V4L_UTILS
	help
	  Enable camera support for visual investigation
	  and motion detection.

config BR2_PACKAGE_GLOWBARN_GPIO
	bool "Enable GPIO sensors"
	default y
	select BR2_PACKAGE_LIBGPIOD
	help
	  Enable GPIO-based sensors
	  (motion, temperature, humidity, etc.)

config BR2_PACKAGE_GLOWBARN_I2C
	bool "Enable I2C sensors"
	default y
	select BR2_PACKAGE_I2C_TOOLS
	help
	  Enable I2C-based sensors
	  (pressure, accelerometer, etc.)

config BR2_PACKAGE_GLOWBARN_SERIAL
	bool "Enable serial sensors"
	default y
	select BR2_PACKAGE_LIBSERIALPORT
	help
	  Enable support for serial/USB sensors
	  (EMF meters, Geiger counters, etc.)

endif
```
